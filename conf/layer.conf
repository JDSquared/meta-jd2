## conf/layer.conf
```bitbake
# We have a conf and classes directory, add to BBPATH
BBPATH .= ":${LAYERDIR}"

# We have a packages directory, add to BBFILES
BBFILES += "${LAYERDIR}/recipes*/*/*.bb \
            ${LAYERDIR}/recipes*/*/*.bbappend"

BBFILE_COLLECTIONS += "jd2-layer"
BBFILE_PATTERN_jd2-layer := "^${LAYERDIR}/"
BBFILE_PRIORITY_jd2-layer = "10"

LAYERSERIES_COMPAT_jd2-layer = "sumo"

LICENSE_PATH += "${LAYERDIR}/custom-licenses"

HOSTTOOLS += " \
    cc dos2unix seq \
"
```

## conf/machine/imx7-jd2-ethcb-var-som.conf
```bitbake
#@TYPE: Machine
#@NAME: JD Squared ETHCB with Variscite VAR-SOM-MX7
#@SOC: i.MX7D
#@DESCRIPTION: Machine configuration for JD Squared ETHCB with Variscite VAR-SOM-MX7
#@MAINTAINER: JD Squared <support@jd2.com>
#
# http://www.jd2.com

MACHINEOVERRIDES =. "mx7:mx7d:"
include conf/machine/include/imx-base.inc
include conf/machine/include/tune-cortexa7.inc

# JD2 BSP default providers
PREFERRED_PROVIDER_virtual/kernel ?= "linux-jd2-rt"
PREFERRED_VERSION_linux-jd2 = "4.9.88"

PREFERRED_PROVIDER_u-boot = "u-boot-jd2-imx"
PREFERRED_PROVIDER_virtual/bootloader = "u-boot-jd2-imx"

PREFERRED_RPROVIDER_ptpd = "ptpd"
PREFERRED_RPROVIDER_ptpd-dev = "ptpd"

MACHINE_EXTRA_RDEPENDS += " \
			   kernel-modules \
			   pm-utils \
			   rng-tools \
			   hdparm \
			   gptfdisk \
			   \
			   " 

# Packages added to all images (including core-image-minimal)
IMAGE_INSTALL_append = " \
        imx-runtime-pwr-disable \
"

BBMASK_prepend = "fsl-image-mfgtool-initramfs "
BBMASK += "meta-freescale/dynamic-layers/browser-layer/recipes-browser/chromium"

WKS_FILE = "imx-uboot-spl-bootpart.wks"
IMAGE_FSTYPES += "tar.gz"

SDCARD_GENERATION_COMMAND_mx7 = "generate_imx_sdcard"

SERIAL_CONSOLE = "115200 ttymxc0"

MACHINE_SOCARCH_FILTER_mx7 = "libfslcodec libfslparser gst-fsl-plugins"

KERNEL_DEVICETREE = " \
		     imx7d-jd2-ethcb-var-som.dtb \
		     "
KERNEL_IMAGETYPE = "zImage"

UBOOT_MAKE_TARGET = ""
SPL_BINARY = "SPL"
UBOOT_SUFFIX = "img"
UBOOT_CONFIG ??= "sd "
# The above order matters. The last one will be also called u-boot-${MACHINE} and will be used to create the sdcard.
UBOOT_CONFIG[sd] = "mx7dvar_som_jd2_ethcb_defconfig,sdcard"

MACHINE_FEATURES_BACKFILL_CONSIDERED = "rtc"
```
